// charybdis_left.overlay

#include "charybdis.dtsi" // Notice that the main dtsi files are included in the overlay.
#include "pmw3610.dtsi"

&kscan0 {
    col-gpios
        = <&pro_micro 5 GPIO_ACTIVE_HIGH>
        , <&pro_micro 6 GPIO_ACTIVE_HIGH>
        , <&pro_micro 7 GPIO_ACTIVE_HIGH>
        , <&pro_micro 8 GPIO_ACTIVE_HIGH>
        , <&pro_micro 9 GPIO_ACTIVE_HIGH>
        ;
};

&trackball_split {
	status = "okay";
};